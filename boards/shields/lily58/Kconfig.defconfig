## boards/shields/lily58/Kconfig.defconfig
```kconfig
# Copyright (c) 2024 The ZMK Contributors
# SPDX-License-Identifier: MIT

if SHIELD_LILY58_LEFT

config ZMK_KEYBOARD_NAME
    default "Lily58 Custom"

config ZMK_SPLIT_ROLE_CENTRAL
    default y

config ZMK_USB
    default y

endif # SHIELD_LILY58_LEFT

if SHIELD_LILY58_LEFT || SHIELD_LILY58_RIGHT

config ZMK_SPLIT
    default y

# RGB underglow config
config ZMK_RGB_UNDERGLOW
    select WS2812_STRIP
    select SPI

# Display (NiceView/OLED)
config ZMK_DISPLAY
    select LV_FONT_MONTSERRAT_26

# Cirque Glidepoint support
if ZMK_MOUSE
config I2C
    default y
endif

# Display detail
if ZMK_DISPLAY

config ZMK_DISPLAY_BLANK_ON_IDLE
    default n

config SPI
    default y

config LS0XX
    default y

config LV_Z_BITS_PER_PIXEL
    default 1

choice LV_COLOR_DEPTH
    default LV_COLOR_DEPTH_1
endchoice

endif # ZMK_DISPLAY

# LVGL rendering backend
if LVGL

config LV_Z_VDB_SIZE
    default 64

config LV_DPI_DEF
    default 148

config LV_Z_BITS_PER_PIXEL
    default 1

choice LV_COLOR_DEPTH
    default LV_COLOR_DEPTH_1
endchoice

endif # LVGL

endif # SHIELD_LILY58_LEFT || SHIELD_LILY58_RIGHT
```

## config/west.yml
```yaml
manifest:
  remotes:
    - name: zmkfirmware
      url-base: https://github.com/zmkfirmware
    # Additional modules containing boards/shields/custom code can be listed here as well
    # See https://docs.zephyrproject.org/3.2.0/develop/west/manifest.html#projects
    # petejohanson is the DEV of ZMK - need his drivers for Cirque
    - name: petejohanson
      url-base: https://github.com/petejohanson
  projects:
    - name: zmk
      remote: zmkfirmware
      revision: main
      import: app/west.yml
    ### below is the modules that are needed for the CIRQUE 40mm Trackpad
    #Pete is a ZMK dev, these are the drivers to make the cirque work
    - name: cirque-input-module
      remote: petejohanson
      revision: main
  self:
    path: config
```
